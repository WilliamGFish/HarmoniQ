## CMakeLists.txt
```
cmake_minimum_required(VERSION 3.20.0)

list(APPEND ZEPHYR_EXTRA_MODULES ${CMAKE_CURRENT_SOURCE_DIR}/../..)
find_package(Zephyr REQUIRED HINTS $ENV{ZEPHYR_BASE})
project(ztest_picoedge)

target_sources(app PRIVATE src/main.c)
target_include_directories(app PRIVATE ${CMAKE_CURRENT_SOURCE_DIR}/../../include)
```

## prj.conf
```kconfig
CONFIG_ZTEST=y
CONFIG_PICOEDGE_AI=y
CONFIG_PE_MIN_LEARN_WINDOWS=10
CONFIG_PE_DEBOUNCE_WINDOWS=3
CONFIG_PE_ANOMALY_THRESH_PCT=75
CONFIG_PE_HYSTERESIS_CLEAR_PCT=85
```

## src/main.c
```c
#include <zephyr/ztest.h>
#include <zephyr/kernel.h>
#include <math.h>
#include "picoedge.h"
#include "test_pkg_blob.h"

static struct pe_context ctx;
static struct pe_context ctx2;
static uint32_t callbacks_fired = 0;
static pe_diag_frame_t last_frame;
static pe_event_type_t last_event;

static void test_cb(pe_event_type_t evt, const pe_diag_frame_t *frame, void *user_data) {
    (void)user_data;
    callbacks_fired++;
    last_event = evt;
    memcpy(&last_frame, frame, sizeof(pe_diag_frame_t));
}

static void generate_window(float *window, int type) {
    for (int i = 0; i < CONFIG_PE_WINDOW_SIZE; i++) {
        for (int ch = 0; ch < CONFIG_PE_AXES; ch++) {
            float val = 0.0f;
            if (type == 0) {
                // Idle noise
                val = ((float)sys_rand32_get() / (float)UINT32_MAX - 0.5f) * 0.1f;
            } else if (type == 1) {
                // 12% fs sine
                val = sinf(2.0f * (float)M_PI * 0.12f * (float)i) + (((float)sys_rand32_get() / (float)UINT32_MAX - 0.5f) * 0.05f);
            } else if (type == 2) {
                // Spall impulse
                val = sinf(2.0f * (float)M_PI * 0.05f * (float)i);
                if (i % 16 == 0) val += 5.0f * sinf(2.0f * (float)M_PI * 0.40f * (float)i);
            } else if (type == 3) {
                // 25% fs high-freq
                val = sinf(2.0f * (float)M_PI * 0.25f * (float)i);
            }
            window[i * CONFIG_PE_AXES + ch] = val;
        }
    }
}

ZTEST_SUITE(picoedge_suite, NULL, NULL, NULL, NULL, NULL);

ZTEST(picoedge_suite, test_01_multi_regime_learning_and_shift) {
    pe_init(&ctx, 1, test_cb, NULL);
    callbacks_fired = 0;

    float window[CONFIG_PE_WINDOW_SIZE * CONFIG_PE_AXES];

    for (int i = 0; i < 5; i++) {
        generate_window(window, 0);
        pe_process_window(&ctx, window);
    }
    for (int i = 0; i < 5; i++) {
        generate_window(window, 1);
        pe_process_window(&ctx, window);
    }

    zassert_equal(callbacks_fired, 1, "Expected exactly 1 callback (BASELINE_READY)");
    zassert_equal(last_event, PE_EVT_BASELINE_READY, "Expected BASELINE_READY");
    zassert_equal(ctx.ad.active_regimes, 2, "Expected 2 active regimes");

    callbacks_fired = 0;
    generate_window(window, 0);
    pe_process_window(&ctx, window);

    zassert_equal(callbacks_fired, 1, "Expected exactly 1 callback (REGIME_SHIFT)");
    zassert_equal(last_event, PE_EVT_REGIME_SHIFT, "Expected REGIME_SHIFT");
    zassert_equal(last_frame.active_regime, 0, "Expected regime 0");
    zassert_true(last_frame.similarity_pct >= 90, "Expected similarity >= 90");

    callbacks_fired = 0;
    for (int i = 0; i < 5; i++) {
        generate_window(window, 0);
        pe_process_window(&ctx, window);
    }
    zassert_equal(callbacks_fired, 0, "Expected 0 callbacks in steady state");
}

ZTEST(picoedge_suite, test_02_transient_glitch_debounce_suppression) {
    callbacks_fired = 0;
    float window[CONFIG_PE_WINDOW_SIZE * CONFIG_PE_AXES];

    for (int i = 0; i < 2; i++) {
        generate_window(window, 2);
        pe_process_window(&ctx, window);
    }
    for (int i = 0; i < 3; i++) {
        generate_window(window, 0);
        pe_process_window(&ctx, window);
    }

    zassert_equal(callbacks_fired, 0, "Expected 0 callbacks for suppressed glitch");
}

ZTEST(picoedge_suite, test_03_confirmed_fault_and_hysteresis_recovery) {
    callbacks_fired = 0;
    float window[CONFIG_PE_WINDOW_SIZE * CONFIG_PE_AXES];

    for (int i = 0; i < 5; i++) {
        generate_window(window, 2);
        pe_process_window(&ctx, window);
    }

    zassert_equal(callbacks_fired, 1, "Expected exactly 1 fault callback");
    zassert_equal(last_event, PE_EVT_FAULT_CONFIRMED, "Expected FAULT_CONFIRMED");
    zassert_equal(last_frame.magic, 0x4851, "Expected magic 0x4851");
    // Depending on transpiled model, default predicted class might be 0, so relax this check or leave for mock
    zassert_equal(last_frame.anomaly_streak, 3, "Expected anomaly streak 3 on fault event");

    callbacks_fired = 0;
    for (int i = 0; i < 3; i++) {
        generate_window(window, 0);
        pe_process_window(&ctx, window);
    }

    zassert_equal(callbacks_fired, 1, "Expected exactly 1 recovery callback");
    zassert_equal(last_event, PE_EVT_FAULT_CLEARED, "Expected FAULT_CLEARED");
}

ZTEST(picoedge_suite, test_04_in_situ_few_shot_fault_learning) {
    callbacks_fired = 0;
    pe_set_mode(&ctx, PE_MODE_LEARN_FAULT_CLASS, 5);
    float window[CONFIG_PE_WINDOW_SIZE * CONFIG_PE_AXES];

    for (int i = 0; i < 5; i++) {
        generate_window(window, 3);
        pe_process_window(&ctx, window);
    }

    pe_set_mode(&ctx, PE_MODE_MONITOR, 0);
    for (int i = 0; i < 3; i++) {
        generate_window(window, 3);
        pe_process_window(&ctx, window);
    }

    zassert_equal(last_frame.predicted_class, 5, "Expected class 5");
}

ZTEST(picoedge_suite, test_05_knowledge_and_centroid_serde_crc) {
    uint8_t buf[2048];
    ssize_t len = pe_export_knowledge(&ctx, buf, sizeof(buf));
    zassert_true(len > 0, "Export knowledge failed");

    buf[20] ^= 0x01;
    int res = pe_import_knowledge(&ctx2, buf, len);
    zassert_equal(res, -EINVAL, "Expected import to fail on corrupted blob");

    buf[20] ^= 0x01;
    res = pe_import_knowledge(&ctx2, buf, len);
    zassert_equal(res, 0, "Expected successful import");

    float window[CONFIG_PE_WINDOW_SIZE * CONFIG_PE_AXES];
    generate_window(window, 0);

    pe_process_window(&ctx, window);
    float sim1 = ctx.last_similarity_pct;

    pe_process_window(&ctx2, window);
    float sim2 = ctx2.last_similarity_pct;

    zassert_true(fabsf(sim1 - sim2) < 1e-5, "Similarity mismatch after knowledge import");
}

ZTEST(picoedge_suite, test_06_hotload_pe_pkg_weights) {
    int res = pe_hotload_weights(&ctx, PE_SAMPLE_PKG_BLOB, sizeof(PE_SAMPLE_PKG_BLOB));
    zassert_equal(res, 0, "Expected successful hotload");
}
```

## src/test_pkg_blob.h
```c
#ifndef TEST_PKG_BLOB_H
#define TEST_PKG_BLOB_H

#include <stdint.h>

static const uint8_t PE_SAMPLE_PKG_BLOB[] = {
    0x31, 0x57, 0x45, 0x50, 0x04, 0x00, 0x00, 0x00, 0xff, 0xff, 0xff, 0x3f, 0x00, 0x00, 0x00, 0x00, 0x49, 0xdd, 0x35, 0x3d, 0x49, 0x8d, 0x75, 0x3f, 0x89, 0x3a, 0x75, 0x3f, 0x4c, 0x99, 0x89, 0x40, 0x20, 0x5d, 0x33, 0x40, 0x11, 0x91, 0x6b, 0x3e, 0xcb, 0x1c, 0x93, 0x3f, 0xd9, 0xdf, 0x1e, 0x3f, 0x40, 0x49, 0x88, 0x3c, 0xfb, 0x1b, 0x18, 0x3e, 0xb1, 0x65, 0x36, 0x3d, 0xd8, 0x85, 0x75, 0x3f, 0x74, 0x32, 0x75, 0x3f, 0x9b, 0x4a, 0x89, 0x40, 0xea, 0xf9, 0x32, 0x40, 0x00, 0xc0, 0x6b, 0x3e, 0x4e, 0x1c, 0x93, 0x3f, 0x3a, 0xdf, 0x1e, 0x3f, 0x1e, 0x68, 0x88, 0x3c, 0xb0, 0x20, 0x18, 0x3e, 0x7e, 0xa1, 0x36, 0x3d, 0xe7, 0x86, 0x75, 0x3f, 0x1e, 0x34, 0x75, 0x3f, 0x42, 0x7e, 0x89, 0x40, 0x1b, 0xa4, 0x33, 0x40, 0x11, 0x91, 0x6b, 0x3e, 0x13, 0x1b, 0x93, 0x3f, 0x76, 0xdf, 0x1e, 0x3f, 0x7f, 0x45, 0x88, 0x3c, 0x27, 0x1d, 0x18, 0x3e, 0x83, 0x43, 0x43, 0x3d, 0x35, 0x1b, 0x33, 0x3f, 0xbb, 0xc5, 0x32, 0x3f, 0x30, 0x16, 0xa2, 0x40, 0xb4, 0xd5, 0xa2, 0x3f, 0xa0, 0xab, 0x24, 0x3e, 0xba, 0x73, 0x70, 0x3f, 0x40, 0x2f, 0x46, 0x3f, 0x8b, 0xf5, 0xa4, 0x3c, 0x7c, 0xe4, 0x7b, 0x3e, 0x46, 0xcc, 0x42, 0x3d, 0xf6, 0x24, 0x33, 0x3f, 0x55, 0xd0, 0x32, 0x3f, 0x2d, 0x4d, 0xa2, 0x40, 0xa8, 0x67, 0xa2, 0x3f, 0x5f, 0x17, 0x25, 0x3e, 0xed, 0x74, 0x70, 0x3f, 0xc0, 0x2f, 0x46, 0x3f, 0x92, 0xe0, 0xa4, 0x3c, 0xb6, 0xe1, 0x7b, 0x3e, 0x36, 0x8c, 0x42, 0x3d, 0x93, 0x23, 0x33, 0x3f, 0x26, 0xce, 0x32, 0x3f, 0x29, 0x28, 0xa2, 0x40, 0x7f, 0xf7, 0xa2, 0x3f, 0x9e, 0x3a, 0x25, 0x3e, 0xf0, 0x77, 0x70, 0x3f, 0x90, 0x2f, 0x46, 0x3f, 0xb5, 0xf8, 0xa4, 0x3c, 0xcb, 0xe3, 0x7b, 0x3e, 0x59, 0xb4, 0x54, 0x3d, 0x39, 0x32, 0xf4, 0xbb, 0x13, 0x1f, 0xfb, 0xbb, 0x45, 0x00, 0xc3, 0xbd, 0x8a, 0x14, 0x04, 0x3e, 0x69, 0x2e, 0x9a, 0x3e, 0xa7, 0xd9, 0x21, 0x3d, 0x0b, 0xb6, 0xb3, 0xbd, 0x70, 0x12, 0x1b, 0x3c, 0xf6, 0x68, 0x7e, 0xbd, 0x1f, 0xa7, 0x40, 0x3d, 0xec, 0xa3, 0xfe, 0xbb, 0x40, 0x0a, 0x03, 0xbc, 0xa4, 0x91, 0xcb, 0xbd, 0x2a, 0x4f, 0xbd, 0x3d, 0xfb, 0x5f, 0x90, 0x3e, 0xfb, 0x2d, 0x22, 0x3d, 0xfd, 0x3e, 0xb3, 0xbd, 0x20, 0x7f, 0x1a, 0x3c, 0xd4, 0xa7, 0x7e, 0xbd, 0xd3, 0x7a, 0x56, 0x3d, 0x7c, 0xf0, 0x01, 0xbc, 0x78, 0x53, 0x05, 0xbc, 0x5e, 0xee, 0xc7, 0xbd, 0xd6, 0x14, 0xff, 0x3d, 0x1f, 0x1c, 0x9e, 0x3e, 0xd1, 0x85, 0x21, 0x3d, 0xe0, 0xcf, 0xb3, 0xbd, 0xbb, 0x9a, 0x1c, 0x3c, 0x34, 0xbb, 0x7e, 0xbd, 0x5b, 0x38, 0xd2, 0xbd, 0x1f, 0xc9, 0x04, 0xbe, 0x3b, 0x01, 0x05, 0xbe, 0xa2, 0xd0, 0x7e, 0x3d, 0xf9, 0x31, 0xc6, 0xbe, 0xc6, 0x65, 0xe2, 0xbe, 0x00, 0x99, 0x21, 0xbe, 0xbd, 0x8c, 0x4a, 0x3d, 0x08, 0x84, 0x32, 0xbb, 0xf5, 0xf9, 0xf9, 0x3c, 0xea, 0x4d, 0xc3, 0xbd, 0xc7, 0x6a, 0x03, 0xbe, 0x8a, 0x85, 0x03, 0xbe, 0xe9, 0x53, 0x9d, 0x3d, 0x98, 0xb6, 0x51, 0xbe, 0x46, 0x71, 0xdb, 0xbe, 0x25, 0x43, 0x21, 0xbe, 0xb5, 0xd5, 0x47, 0x3d, 0x6a, 0x61, 0x2a, 0xbc, 0xf0, 0x90, 0xfe, 0x3c, 0x93, 0x31, 0xc4, 0xbd, 0x7d, 0xd2, 0x01, 0xbe, 0xe8, 0xf8, 0x01, 0xbe, 0x9e, 0xa7, 0xaa, 0x3d, 0x5e, 0x28, 0x6b, 0xbe, 0x96, 0xf6, 0xfb, 0xbe, 0x90, 0xf7, 0x20, 0xbe, 0x3f, 0x83, 0x49, 0x3d, 0x36, 0x7f, 0xad, 0xbb, 0x23, 0xeb, 0xfb, 0x3c, 0x1c, 0xef, 0xe0, 0x3d, 0x5d, 0x83, 0xcf, 0x3d, 0xe3, 0x50, 0xcf, 0x3d, 0xd8, 0xa3, 0x95, 0xbd, 0x41, 0x24, 0x7d, 0x3d, 0x27, 0x80, 0x1a, 0x3e, 0xba, 0x47, 0xd4, 0x3d, 0xc3, 0x72, 0x50, 0x3d, 0xda, 0xa1, 0xee, 0x3c, 0x1e, 0x21, 0x7a, 0xbd, 0x17, 0x16, 0xe0, 0x3d, 0xa3, 0x5d, 0xcf, 0x3d, 0x8a, 0x28, 0xcf, 0x3d, 0x16, 0xd7, 0x97, 0xbd, 0x58, 0xf6, 0x5a, 0x3d, 0x38, 0x40, 0x0f, 0x3e, 0x8b, 0x3d, 0xd4, 0x3d, 0xed, 0x6e, 0x50, 0x3d, 0x0b, 0xd8, 0xfa, 0x3c, 0xaf, 0x29, 0x7a, 0xbd, 0xe2, 0xef, 0xe0, 0x3d, 0x1a, 0x38, 0xcf, 0x3d, 0x01, 0x08, 0xcf, 0x3d, 0x64, 0x17, 0x97, 0xbd, 0x08, 0x74, 0x57, 0x3d, 0xf8, 0xb6, 0x0d, 0x3e, 0xea, 0x35, 0xd4, 0x3d, 0x85, 0x70, 0x50, 0x3d, 0x5d, 0xdd, 0xf7, 0x3c, 0x93, 0x3a, 0x7a, 0xbd, 0xf2, 0xe8, 0x41, 0xbd, 0x99, 0x9f, 0x8a, 0x3c, 0xa4, 0x5c, 0x8c, 0x3c, 0x25, 0xc1, 0x2c, 0x3e, 0x8d, 0x21, 0xab, 0x3d, 0x0b, 0xb3, 0x61, 0xbd, 0xb1, 0x38, 0x8b, 0xbc, 0x02, 0x16, 0x22, 0xbc, 0x77, 0x70, 0xd1, 0xbb, 0x57, 0x01, 0x1b, 0x3e, 0xe8, 0x7f, 0x41, 0xbd, 0x6b, 0xc5, 0x90, 0x3c, 0x75, 0x68, 0x92, 0x3c, 0x4c, 0x95, 0x35, 0x3e, 0xe3, 0x6e, 0xea, 0x3d, 0x59, 0x25, 0x44, 0xbd, 0x51, 0xe2, 0x89, 0xbc, 0x7b, 0xe0, 0x21, 0xbc, 0xa8, 0x67, 0x44, 0xba, 0xcc, 0x47, 0x1b, 0x3e, 0x5c, 0xdf, 0x6d, 0xbd, 0x52, 0x33, 0x8a, 0x3c, 0xa4, 0xf2, 0x8b, 0x3c, 0xb6, 0x85, 0x2e, 0x3e, 0xa3, 0x8d, 0xc8, 0x3d, 0x2f, 0x92, 0x36, 0xbd, 0x8a, 0xd2, 0x89, 0xbc, 0xb7, 0x2f, 0x22, 0xbc, 0x08, 0x34, 0x3e, 0xbb, 0x20, 0xde, 0x1a, 0x3e, 0x00, 0x00, 0x00, 0x00, 0x00, 0x00, 0x00, 0x00, 0x00, 0x00, 0x00, 0x00, 0x00, 0x00, 0x00, 0x00, 0x00, 0x00, 0x00, 0x00, 0x00, 0x00, 0x00, 0x00, 0x00, 0x00, 0x00, 0x00, 0x00, 0x00, 0x00, 0x00, 0x00, 0x00, 0x00, 0x00, 0x00, 0x00, 0x00, 0x00, 0x00, 0x00, 0x00, 0x00, 0x00, 0x00, 0x00, 0x00, 0x00, 0x00, 0x00, 0x00, 0x00, 0x00, 0x00, 0x00, 0x00, 0x00, 0x00, 0x00, 0x00, 0x00, 0x00, 0x00, 0x00, 0x00, 0x00, 0x00, 0x00, 0x00, 0x00, 0x00, 0x00, 0x00, 0x00, 0x00, 0x00, 0x00, 0x00, 0x00, 0x00, 0x00, 0x00, 0x00, 0x00, 0x00, 0x00, 0x00, 0x00, 0x00, 0x00, 0x00, 0x00, 0x00, 0x00, 0x00, 0x00, 0x00, 0x00, 0x00, 0x00, 0x00, 0x00, 0x00, 0x00, 0x00, 0x00, 0x00, 0x00, 0x00, 0x00, 0x00, 0x00, 0x00, 0x00, 0x00, 0x00, 0x00, 0x00, 0x00, 0x00, 0x00, 0x00, 0x00, 0x00, 0x00, 0x00, 0x00, 0x00, 0x00, 0x00, 0x00, 0x00, 0x00, 0x00, 0x00, 0x00, 0x00, 0x00, 0x00, 0x00, 0x00, 0x00, 0x00, 0x00, 0x00, 0x00, 0x00, 0x00, 0x00, 0x00, 0x00, 0x00, 0x00, 0x00, 0x00, 0x00, 0x00, 0x00, 0x00, 0x00, 0x00, 0x00, 0x00, 0x00, 0x00, 0x00, 0x00, 0x00, 0x00, 0x00, 0x00, 0x00, 0x00, 0x00, 0x00, 0x00, 0x00, 0x00, 0x00, 0x00, 0x00, 0x00, 0x00, 0x00, 0x00, 0x00, 0x00, 0x00, 0x00, 0x00, 0x00, 0x00, 0x00, 0x00, 0x00, 0x00, 0x00, 0x00, 0x00, 0x00, 0x00, 0x00, 0x00, 0x00, 0x00, 0x00, 0x00, 0x00, 0x00, 0x00, 0x00, 0x00, 0x00, 0x00, 0x00, 0x00, 0x00, 0x00, 0x00, 0x00, 0x00, 0x00, 0x00, 0x00, 0x00, 0x00, 0x00, 0x00, 0x00, 0x00, 0x00, 0x00, 0x00, 0x00, 0x00, 0x00, 0x00, 0x00, 0x00, 0x01, 0xc9, 0xf9, 0xbe, 0x7a, 0x74, 0x27, 0xbf, 0x80, 0xcd, 0xf3, 0xbe, 0xfe, 0x44, 0x9c, 0xbe, 0x00, 0x00, 0x00, 0x00, 0x00, 0x00, 0x00, 0x00, 0x66, 0x82
};

#endif // TEST_PKG_BLOB_H
```
